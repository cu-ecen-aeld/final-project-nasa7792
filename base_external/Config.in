## base_external/Config.in
```kconfig
source "$BR2_EXTERNAL_project_base_PATH/package/hello_package/Config.in"
source "$BR2_EXTERNAL_project_base_PATH/package/test_gpio/Config.in"
source "$BR2_EXTERNAL_project_base_PATH/package/vncl_new/Config.in"
source "$BR2_EXTERNAL_project_base_PATH/package/pinet_sender/Config.in"
source "$BR2_EXTERNAL_project_base_PATH/package/pinet_receiver/Config.in"
source "$BR2_EXTERNAL_project_base_PATH/package/pinet_driver/Config.in"
source "$BR2_EXTERNAL_project_base_PATH/package/servo_test2/Config.in"
```

## base_external/configs/aesd_rpi_defconfig
```kconfig
BR2_arm=y
BR2_cortex_a72=y
BR2_ARM_FPU_NEON_VFPV4=y
BR2_PACKAGE_HOST_LINUX_HEADERS_CUSTOM_6_1=y
BR2_TOOLCHAIN_BUILDROOT_CXX=y
BR2_TARGET_GENERIC_HOSTNAME="root"
BR2_TARGET_GENERIC_ISSUE="new buildroot image"
BR2_TARGET_GENERIC_ROOT_PASSWD="root"
BR2_SYSTEM_DHCP="eth0"
BR2_ROOTFS_OVERLAY="../base_external/rootfs_overlay"
BR2_ROOTFS_POST_BUILD_SCRIPT="board/raspberrypi4/post-build.sh"
BR2_ROOTFS_POST_IMAGE_SCRIPT="board/raspberrypi4/post-image.sh"
BR2_LINUX_KERNEL=y
BR2_LINUX_KERNEL_CUSTOM_TARBALL=y
BR2_LINUX_KERNEL_CUSTOM_TARBALL_LOCATION="$(call github,raspberrypi,linux,17f135b742c4edb340afb365873c3a574f7e16cb)/linux-17f135b742c4edb340afb365873c3a574f7e16cb.tar.gz"
BR2_LINUX_KERNEL_DEFCONFIG="bcm2711"
BR2_LINUX_KERNEL_DTS_SUPPORT=y
BR2_LINUX_KERNEL_INTREE_DTS_NAME="bcm2711-rpi-4-b"
BR2_LINUX_KERNEL_NEEDS_HOST_OPENSSL=y
BR2_PACKAGE_BUSYBOX_SHOW_OTHERS=y
BR2_PACKAGE_ALSA_UTILS=y
BR2_PACKAGE_ALSA_UTILS_AMIXER=y
BR2_PACKAGE_ALSA_UTILS_APLAY=y
BR2_PACKAGE_ALSA_UTILS_SPEAKER_TEST=y
BR2_PACKAGE_MADPLAY=y
BR2_PACKAGE_MPG123=y
BR2_PACKAGE_XZ=y
BR2_PACKAGE_FBV=y
BR2_PACKAGE_PSPLASH=y
BR2_PACKAGE_PSPLASH_IMAGE="/home/nalin/Desktop/mountain.bmp"
BR2_PACKAGE_RPI_FIRMWARE=y
BR2_PACKAGE_RPI_FIRMWARE_VARIANT_PI4=y
BR2_PACKAGE_RPI_FIRMWARE_CONFIG_FILE="board/raspberrypi4/config_4.txt"
BR2_PACKAGE_I2C_TOOLS=y
BR2_PACKAGE_LIBGPIOD=y
BR2_PACKAGE_LIBNFC=y
BR2_PACKAGE_LIBNFC_PN532_I2C=y
BR2_PACKAGE_KMOD=y
BR2_PACKAGE_KMOD_TOOLS=y
BR2_TARGET_ROOTFS_EXT2=y
BR2_TARGET_ROOTFS_EXT2_4=y
BR2_TARGET_ROOTFS_EXT2_SIZE="120M"
# BR2_TARGET_ROOTFS_TAR is not set
BR2_PACKAGE_HOST_DOSFSTOOLS=y
BR2_PACKAGE_HOST_GENIMAGE=y
BR2_PACKAGE_HOST_IMAGEMAGICK=y
BR2_PACKAGE_HOST_KMOD_XZ=y
BR2_PACKAGE_HOST_MTOOLS=y
BR2_PACKAGE_HELLO_PACKAGE=y
BR2_PACKAGE_TEST_GPIO=y
BR2_PACKAGE_VNCL=y
```

## base_external/package/hello_package/Config.in
```kconfig
config BR2_PACKAGE_HELLO_PACKAGE
	bool "hello_package"
	help
	  Includes the writer executable, finder.sh and tester.sh in the kernel image.
	  Used to understand buildroot external trees and package builds.
```

## base_external/package/pinet_driver/Config.in
```kconfig
config BR2_PACKAGE_PINET_DRIVER
	bool "pinet_driver"
	help
        pinet network Driver module 
```

## base_external/package/pinet_receiver/Config.in
```kconfig
config BR2_PACKAGE_PINET_RECEIVER
	bool "pinet_receiver"
	help
		includes pinet reciever socket
```

## base_external/package/pinet_sender/Config.in
```kconfig
config BR2_PACKAGE_PINET_SENDER
	bool "pinet_sender"
	help
		include pinet transmiter socket
```

## base_external/package/servo_test2/Config.in
```kconfig
config BR2_PACKAGE_SERVO_TEST2
	bool "servo_test2"
	help
		a test package for servo motor(pwm Device)
```

## base_external/package/test_gpio/Config.in
```kconfig
config BR2_PACKAGE_TEST_GPIO
	bool "test_gpio"
	help
	  Includes the writer executable, finder.sh and tester.sh in the kernel image.
	  Used to understand buildroot external trees and package builds.
```
